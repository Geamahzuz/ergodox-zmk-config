#define TAPPING_TERM 175
#define TD_TAPPING_TERM 225
#define QUICK_TAP_TERM 175
#define ADAPTIVE_KEY_TIMEOUT 300

&mt {
  tapping-term-ms = <TAPPING_TERM>;
  flavor = "tap-preferred";
  quck-tap-ms = <QUICK_TAP_TERM>;
};

&lt {
  tapping-term-ms = <TAPPING_TERM>;
  flavor = "tap-preferred";
  quick-tap-ms = <QUICK_TAP_TERM>;
};

&sl {
  release-after-ms = <1000>;
  quick-release;
};

&sk {
  release-after-ms = <1000>;
  quick-release;
};
